## meta-neon/conf/distro/NeonOS.conf
```bitbake
DISTRO = "NeonOS"
DISTRO_NAME = "Neon OS"
DISTRO_VERSION = "1.0"
DISTRO_FEATURES:append = " systemd wifi usrmerge"

VIRTUAL-RUNTIME_init_manager = "systemd"
VIRTUAL-RUNTIME_initscripts = ""
DISTRO_FEATURES_BACKFILL_CONSIDERED = "sysvinit"

# 包管理可視需要選 ipk 或 rpm
PACKAGE_CLASSES ?= "package_ipk"
```

## meta-neon/conf/layer.conf
```bitbake
# We have a conf and classes directory, add to BBPATH
BBPATH .= ":${LAYERDIR}"

# We have recipes-* directories, add to BBFILES
BBFILES += "${LAYERDIR}/recipes-*/*/*.bb \
            ${LAYERDIR}/recipes-*/*/*.bbappend"

BBFILE_COLLECTIONS += "meta-neon"
BBFILE_PATTERN_meta-neon = "^${LAYERDIR}/"
BBFILE_PRIORITY_meta-neon = "6"

LAYERDEPENDS_meta-neon = "core"
LAYERSERIES_COMPAT_meta-neon = "dunfell"
```
